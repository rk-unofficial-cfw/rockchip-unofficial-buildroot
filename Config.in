## Config.in
```kconfig
source "$BR2_EXTERNAL_ROCKCHIP_UNOFFICIAL_BUILDROOT_PATH/packages/rkfw/Config.in"
source "$BR2_EXTERNAL_ROCKCHIP_UNOFFICIAL_BUILDROOT_PATH/packages/uboot-rk3128atv-legacy/Config.in"
source "$BR2_EXTERNAL_ROCKCHIP_UNOFFICIAL_BUILDROOT_PATH/packages/uboot-rk3128atv/Config.in"
```

## configs/rk3128_612_defconfig
```kconfig
BR2_arm=y
BR2_cortex_a7=y
BR2_ARM_FPU_NEON_VFPV4=y
BR2_PACKAGE_HOST_LINUX_HEADERS_CUSTOM_6_12=y
BR2_GLOBAL_PATCH_DIR="$(BR2_EXTERNAL_ROCKCHIP_UNOFFICIAL_BUILDROOT_PATH)/board/rockchip/common/patches $(BR2_EXTERNAL_ROCKCHIP_UNOFFICIAL_BUILDROOT_PATH)/board/rockchip/rk3128/patches"
BR2_ROOTFS_DEVICE_CREATION_DYNAMIC_EUDEV=y
BR2_SYSTEM_DHCP="eth0"
BR2_ROOTFS_POST_BUILD_SCRIPT="$(BR2_EXTERNAL_ROCKCHIP_UNOFFICIAL_BUILDROOT_PATH)/board/rockchip/rk3128/post-build.sh"
BR2_ROOTFS_POST_IMAGE_SCRIPT="support/scripts/genimage.sh"
BR2_ROOTFS_POST_SCRIPT_ARGS="-c $(BR2_EXTERNAL_ROCKCHIP_UNOFFICIAL_BUILDROOT_PATH)/board/rockchip/rk3128/genimage.cfg"
BR2_LINUX_KERNEL=y
BR2_LINUX_KERNEL_CUSTOM_VERSION=y
BR2_LINUX_KERNEL_CUSTOM_VERSION_VALUE="6.12.16"
BR2_LINUX_KERNEL_PATCH="$(BR2_EXTERNAL_ROCKCHIP_UNOFFICIAL_BUILDROOT_PATH)/board/rockchip/common/kernel-612-patches $(BR2_EXTERNAL_ROCKCHIP_UNOFFICIAL_BUILDROOT_PATH)/board/rockchip/rk3128/kernel-612-patches"
BR2_LINUX_KERNEL_USE_CUSTOM_CONFIG=y
BR2_LINUX_KERNEL_CUSTOM_CONFIG_FILE="$(BR2_EXTERNAL_ROCKCHIP_UNOFFICIAL_BUILDROOT_PATH)/board/rockchip/rk3128/linux_612.arm.conf"
BR2_LINUX_KERNEL_DTS_SUPPORT=y
BR2_LINUX_KERNEL_INTREE_DTS_NAME="rockchip/rk3128-box"
BR2_LINUX_KERNEL_NEEDS_HOST_OPENSSL=y
BR2_PACKAGE_ALSA_UTILS=y
BR2_PACKAGE_ALSA_UTILS_APLAY=y
BR2_TARGET_ROOTFS_EXT2=y
BR2_TARGET_ROOTFS_EXT2_4=y
BR2_TARGET_ROOTFS_EXT2_SIZE="128M"
BR2_TARGET_ROOTFS_EXT2_INODE_SIZE=0
# BR2_TARGET_ROOTFS_TAR is not set
BR2_PACKAGE_HOST_DOSFSTOOLS=y
BR2_PACKAGE_HOST_GENEXT2FS=y
BR2_PACKAGE_HOST_GENIMAGE=y
BR2_PACKAGE_HOST_MTOOLS=y
```

## packages/uboot-rk3128atv-legacy/Config.in
```kconfig
config BR2_PACKAGE_UBOOT_RK3128ATV_LEGACY
    bool "uboot for rockchip 3128 atv legacy"
    help
        uboot for rockchip 3128 atv legacy
```

## packages/uboot-rk3128atv/Config.in
```kconfig
config BR2_PACKAGE_UBOOT_RK3128ATV
    bool "uboot for rockchip 3128 atv"
    help
        uboot for rockchip 3128 atv
```
